//network
#include <WiFi.h>
#include <esp_now.h>



void formatMacAddress(const uint8_t *macAddr, char *buffer, int maxLength)
{
  snprintf(buffer, maxLength, "%02x:%02x:%02x:%02x:%02x:%02x", macAddr[0], macAddr[1], macAddr[2], macAddr[3], macAddr[4], macAddr[5]);
}
 
void receiveCallback(const uint8_t *macAddr, const uint8_t *data, int dataLen)
{
  
  char buffer[ESP_NOW_MAX_DATA_LEN + 1];
  int msgLen = min(ESP_NOW_MAX_DATA_LEN, dataLen);
  strncpy(buffer, (const char *)data, msgLen);
  buffer[msgLen] = 0;
  char macStr[18];
  formatMacAddress(macAddr, macStr, 18);
  Serial.printf("Received message from: %s - %s\n", macStr, buffer);
  if (msgLen != 0) 
  {
  clignoter();
  notification(buffer);
  
  }
}

void sentCallback(const uint8_t *macAddr, esp_now_send_status_t status)
// Data are sent
{
  char macStr[18];
  formatMacAddress(macAddr, macStr, 18);
  Serial.print("Last Packet Sent to: ");
  Serial.println(macStr);
  Serial.print("Last Packet Send Status: ");
  Serial.println(status == ESP_NOW_SEND_SUCCESS ? "Delivery Success" : "Delivery Fail");
}

void broadcast(const String &message)
// broadcast all the data
{
  // Broadcast a message to everyone around
  uint8_t broadcastAddress[] = {0xFF, 0xFF, 0xFF, 0xFF, 0xFF, 0xFF};
  Serial.println("1");
  esp_now_peer_info_t peerInfo = {};
  Serial.println("2");
  memcpy(&peerInfo.peer_addr, broadcastAddress, 6);
  Serial.println("3");
  if (!esp_now_is_peer_exist(broadcastAddress))
  {
    esp_now_add_peer(&peerInfo);
    Serial.println("4");
  }
  // Send message
  esp_err_t result = esp_now_send(broadcastAddress, (const uint8_t *)message.c_str(), message.length());
  Serial.println("5");
  // Print results 
  if (result == ESP_OK)
  {
    Serial.println("Broadcast message success");
    Serial.println("6");
  }
  else if (result == ESP_ERR_ESPNOW_NOT_INIT)
  {
    Serial.println("ESP-NOW not Init.");
    Serial.println("7");
  }
  else if (result == ESP_ERR_ESPNOW_ARG)
  {
    Serial.println("Invalid Argument");
  }
  else if (result == ESP_ERR_ESPNOW_INTERNAL)
  {
    Serial.println("Internal Error");
  }
  else if (result == ESP_ERR_ESPNOW_NO_MEM)
  {
    Serial.println("ESP_ERR_ESPNOW_NO_MEM");
  }
  else if (result == ESP_ERR_ESPNOW_NOT_FOUND)
  {
    Serial.println("Peer not found.");
  }
  else
  {
    Serial.println("Unknown error");
  }
}

//display
#include <Wire.h>
#include <Adafruit_GFX.h>
#include <Adafruit_SSD1306.h>
#include <Keypad.h>


//definition display 
#define SCREEN_WIDTH 128
#define SCREEN_HEIGHT 64
#define OLED_RESET -1
#define SCREEN_ADDRESS 0x3C

#define ROWS  3 // Trois lignes
#define COLS  3 // Trois colonnes

// Paramètres de la clé
#define O_1 20
#define O_2 10
#define O_3 0
#define I_1 7
#define I_2 8
#define I_3 9


byte rowPins[ROWS] = {O_1, O_2, O_3};
byte colPins[COLS] = {I_1, I_2, I_3};

char keys[ROWS][COLS] = {
  {'U', 'L', 'D'},
  {'R', 'X', 'S'},
  {'A', 'B', 'Y'}
};

Keypad keypad = Keypad(makeKeymap(keys), rowPins, colPins, ROWS, COLS);

Adafruit_SSD1306 display(SCREEN_WIDTH, SCREEN_HEIGHT, &Wire, OLED_RESET);


// LEDS
#include <Adafruit_NeoPixel.h>
int currentColorIndex = 0;
#define LED_PIN    4  // Broche de signal des LEDs
#define NUM_LEDS   6 // Nombre de LEDs
#define BRIGHTNESS 50 // Luminosité (0-255)

 

Adafruit_NeoPixel strip = Adafruit_NeoPixel(NUM_LEDS, LED_PIN, NEO_GRB + NEO_KHZ800);
const uint8_t messageIcon[] PROGMEM = {

  0x00, 0x00, 0x00, 0x00, 0x00, 0x00, 0x00, 0x00, 0x00, 0x00, 0x00, 0x00, 0x00, 0x00, 0x00, 0x00,

  0x00, 0x00, 0x00, 0x00, 0x00, 0x00, 0x00, 0x00, 0x00, 0x00, 0x00, 0x00, 0x00, 0x00, 0x00, 0x00,
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  0x00, 0x00, 0x00, 0x00, 0x00, 0x00, 0x00, 0x00, 0x00, 0x00, 0x00, 0x00, 0x00, 0x00, 0x00, 0x00

};

 

const uint8_t ecranLED[] PROGMEM = {

  0x00, 0x00, 0x00, 0x00, 0x00, 0x00, 0x00, 0x00, 0x00, 0x00, 0x00, 0x00, 0x00, 0x00, 0x00, 0x00, 
	0x00, 0x00, 0x00, 0x00, 0x00, 0x00, 0x00, 0x00, 0x00, 0x00, 0x00, 0x00, 0x00, 0x00, 0x00, 0x00, 
	0x00, 0x00, 0x00, 0x00, 0x00, 0x00, 0x00, 0x00, 0x00, 0x00, 0x07, 0x00, 0x00, 0x00, 0x00, 0x00, 
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	0x00, 0x00, 0x00, 0x00, 0x00, 0x00, 0x00, 0x00, 0x00, 0x00, 0x00, 0x00, 0x00, 0x00, 0x00, 0x00

};

 

const uint8_t jeu[] PROGMEM = {

  0x00, 0x00, 0x00, 0x00, 0x00, 0x00, 0x00, 0x00, 0x00, 0x00, 0x00, 0x00, 0x00, 0x00, 0x00, 0x00,

  0x00, 0x00, 0x00, 0x00, 0x00, 0x00, 0x00, 0x00, 0x00, 0x00, 0x00, 0x00, 0x00, 0x00, 0x00, 0x00,
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  0x00, 0x00, 0x00, 0x00, 0x00, 0x00, 0x00, 0x00, 0x00, 0x00, 0x00, 0x00, 0x00, 0x00, 0x00, 0x00

};



//écran d'accueil à afficher après la connexion avec choix 1 messages choix 2 jeu

void drawWelcomeScreen() {
  display.clearDisplay();
  display.drawBitmap(0, 0, messageIcon, 128, 64, SSD1306_WHITE);
  display.display();

}

 



 

//JEU

void drawGameScreen() {
  display.drawBitmap(0, 0, jeu, 128, 64, SSD1306_WHITE);
  display.display();
}


//ECRAN LED ARC EN CIEL

void LEDScreen() {
  display.drawBitmap(0, 0, ecranLED, 128, 64, SSD1306_WHITE);
  display.display();
}
 

//LED

void drawLedScreen() {
  display.clearDisplay();
  display.setTextSize(1);
  display.setTextColor(SSD1306_WHITE);
  display.setCursor(0, 0);
  display.println("LED");
  display.display();

}

 

// Fonction pour définir la couleur de toutes les LEDs

void setColor(uint32_t color) {

  for (int i = 0; i < strip.numPixels(); i++) {
    strip.setPixelColor(i, color);
  }
  strip.show();

}

// Fonction pour éteindre toutes les LEDs

void turnOff() {
  setColor(strip.Color(0, 0, 0)); // Noir (LED éteinte)
}


void clignoter() {
    setColor(strip.Color(255, 0, 0)); // Rouge
    delay(100);
    turnOff();
    delay(100);
    
    setColor(strip.Color(0, 255, 0)); // Vert
    delay(100);
    turnOff();
    delay(100);

    setColor(strip.Color(0, 0, 255)); // Bleu
    delay(100);
    turnOff();
    delay(100);
    // Set the color based on the current color index
    setColor(getColorByIndex(currentColorIndex));

}


//TIC TAC TOE

int matrix[3][3] = {
    {'.', '.', '.'},
    {'.', '.', '.'},
    {'.', '.', '.'}
};
int x =0;
int y =0;
bool playerXTurn = true; // true for X, false for O
void drawBoard() {
    display.clearDisplay();

    // Draw horizontal lines
    for (int i = 1; i < 3; i++) {
        display.drawLine(0, i * 21, 128, i * 21, WHITE);
    }

    // Draw vertical lines
    for (int i = 1; i < 3; i++) {
        display.drawLine(i * 42, 0, i * 42, 64, WHITE);
    }

    // Draw X and O on the board
    for (int i = 0; i < 3; i++) {
        for (int j = 0; j < 3; j++) {
            if (matrix[i][j] == 'X') {
                display.drawLine(j * 42, i * 21, (j + 1) * 42, (i + 1) * 21, WHITE);
                display.drawLine(j * 42, (i + 1) * 21, (j + 1) * 42, i * 21, WHITE);
            } else if (matrix[i][j] == 'O') {
                display.drawCircle(j * 42 + 21, i * 21 + 10, 10, WHITE);
            }
        }
    }

    display.display();
}

char getKeyPressed() {
  return keypad.getKey();
}

void makeMove(int row, int col) {
    if (matrix[row][col] == '.') {
        matrix[row][col] = (playerXTurn) ? 'X' : 'O';
        playerXTurn = !playerXTurn;
    }
}


void deplacement(int row, int col) {
    // Add logic for movement

    if (matrix[row][col] == '.') {
        drawBoard(); 
        display.drawRect(col * 42 + 5, row * 21 + 5, 32, 14, WHITE); 
        display.display();
    }
}
bool win = false;
void checkForWin() {
    for (int i = 0; i < 3; i++){
        if((matrix[i][0] != '.' && matrix[i][0]== matrix[i][1] && matrix[i][0]== matrix[i][2]) || (matrix[0][i] != '.' && matrix[0][i]== matrix[1][i] && matrix[0][i]== matrix[2][i]) || (matrix[0][0] != '.' && matrix[0][0]== matrix[1][1] && matrix[0][0]== matrix[2][2]) || (matrix[2][0] != '.' && matrix[2][0]== matrix[1][1] && matrix[2][0]== matrix[0][2])){
          delay(3000);
          display.clearDisplay();
          display.setTextSize(3);
          display.setTextColor(SSD1306_WHITE);
          display.setCursor(32, 10);
          display.println("WIN");
          display.display();
          delay(4000);  
          display.clearDisplay();
          win = true;
          
        }
        else checkFull();
    }

}

void checkFull(){
  int cpt = 0;
  for(int i =0; i<3; i++){
    for(int j =0; j<3; j++){
      if(matrix[i][j] !='.') cpt= cpt+1;
    }
  }
  if(cpt == 9){
    delay(3000);
          display.clearDisplay();
          display.setTextSize(1);
          display.setTextColor(SSD1306_WHITE);
          display.setCursor(32, 10);
          display.println("Fin personne");
          display.println("n'a gagne");
          display.display();
          delay(4000);  
          display.clearDisplay();
  }
}







//début

void setup() {

  Serial.begin(115200);
  delay(1000);

  strip.begin();
  // Set initial color to blue
  setColor(strip.Color(255, 0, 0));
  strip.show(); // Display the initial color BLEUUUU



  if (!display.begin(SSD1306_SWITCHCAPVCC, SCREEN_ADDRESS)) {

    Serial.println(F("SSD1306 allocation failed"));

    for (;;)

      ;

  }



  //WIFI START
  // Set ESP32 in STA mode 

  WiFi.mode(WIFI_STA);
  Serial.println("ESP-NOW Broadcast Demo");
  // Print MAC address
  Serial.print("MAC Address: ");
  Serial.println(WiFi.macAddress());
  WiFi.disconnect();

  // Initialization of ESP
  if (esp_now_init() == ESP_OK)
  {
    Serial.println("ESP-NOW Init Success");
    esp_now_register_recv_cb(receiveCallback);
    esp_now_register_send_cb(sentCallback);

  }
  else
  {
    Serial.println("ESP-NOW Init Failed");
    delay(3000);
    ESP.restart();

  }
  drawWelcomeScreen();
}



// Function to set the color of the LED
void changeLedColor(uint32_t color) {

  for (int i = 0; i < strip.numPixels(); i++) {
    strip.setPixelColor(i, color);
  }
  strip.show();

}

int red = 0;
int green = 0;
int blue = 0;

 




uint32_t getColorByIndex(int index) {
  switch (index) {
    case 0: return strip.Color(255, 0, 0);
    case 1: return strip.Color(0, 255, 0);
    case 2: return strip.Color(0, 0, 255);
    case 3: return strip.Color(255, 255, 0);
    case 4: return strip.Color(255, 0, 255);
    case 5: return strip.Color(0, 255, 255);
    case 6: return strip.Color(255, 128, 0);
    case 7: return strip.Color(128, 255, 0);
    case 8: return strip.Color(0, 128, 255);
    case 9: return strip.Color(128, 0, 255);
    default: return strip.Color(0, 0, 0); // Default to off
  }
}

 

// Définir les états possibles
enum State {
  WELCOME_SCREEN,
  MESSAGE_SCREEN,
  GAME_SCREEN,
  LED_SCREEN

};

 

// Variable d'état initiale
State currentState = WELCOME_SCREEN;

 

void displayMessageEnvoye(const char *message) {
  display.clearDisplay();
  display.setTextSize(1);
  display.setTextColor(SSD1306_WHITE);
  display.setCursor(0, 0);
  display.println(message);
  display.display();
  delay(1000);
  display.clearDisplay();

}

bool messageDisplayed = false;

 

void notification(const char *buffer)
{
  display.clearDisplay();
  display.setTextSize(2);
  display.setTextColor(SSD1306_WHITE);
  display.setCursor(20, 15);
  display.println(buffer);
  display.display();
  
  messageDisplayed = true;

 
  
  while (messageDisplayed)

  {
    char buttonPressed = getKeyPressed();
    if (buttonPressed == 'A')
    {
      display.clearDisplay();
      display.display();
      messageDisplayed = false;
    }
  }
  display.clearDisplay();
}

//Messags prédéfinis
const char *messages[] = {
  "Hello ! ca va ?",
  "T'as faim ?",
  "Oui carrement",
  "Non flemme",
  "macdo ou bk ?",
  "Hello ! ",
  "Tu es disponible?",
  "Ahahahahahaha",
  "Mhhhhh",
  "A plus tard"
};

const int numMessages = sizeof(messages) / sizeof(messages[0]);
int selectedMessageIndex = 0;
int maxDisplayLines=5;

void displayMessages() {
  int startIndex = max(0, selectedMessageIndex - maxDisplayLines + 1);
  
  display.setTextSize(1);
  display.setTextColor(SSD1306_WHITE);
  display.clearDisplay();
  
  // Display the header
  display.setCursor(0, 0);
  display.println(F("Select a message:"));
  
  // Display the dropdown list
  display.setCursor(0, 20);
  for (int i = startIndex; i < min(numMessages, startIndex + maxDisplayLines); i++) {
    // Print the message
    if (i == selectedMessageIndex) {
      display.setTextColor(SSD1306_BLACK, SSD1306_WHITE);
    } else {
      display.setTextColor(SSD1306_WHITE, SSD1306_BLACK);
    }

    display.println(messages[i]);
  }

  display.display();
}

void handleButtonDown() {
    selectedMessageIndex = (selectedMessageIndex + 1) % numMessages;
  }

void handleButtonUp() {
    selectedMessageIndex = (selectedMessageIndex - 1 + numMessages) % numMessages;

  }


void loop() {

      while (currentState == WELCOME_SCREEN) {
        drawWelcomeScreen();
        char welcomeKeyPressed = getKeyPressed();

        if (welcomeKeyPressed == 'L') {
          display.clearDisplay();

          currentState = MESSAGE_SCREEN;

          while (currentState == MESSAGE_SCREEN) {

            char KeyPressed = getKeyPressed();
              //display.clearDisplay();
              displayMessages();

            if (KeyPressed == 'B') {

              currentState = WELCOME_SCREEN;

            } else if (KeyPressed == 'X') {

              broadcast(messages[selectedMessageIndex]);
              displayMessageEnvoye(messages[selectedMessageIndex]);
            }
            else if (KeyPressed == 'U') {

              handleButtonUp();

            } else if (KeyPressed == 'D'){
                handleButtonDown();
            }
 
            }

          }

         else if (welcomeKeyPressed == 'R') {

          currentState = GAME_SCREEN;

          while (currentState == GAME_SCREEN) {

            char BackKeyPressed = getKeyPressed();

            if (BackKeyPressed == 'B') {

              currentState = WELCOME_SCREEN;

            } else {

              char key = getKeyPressed();

    if (key != NO_KEY) {
        // Handle key press
        switch (key) {
        case 'U':
            if (x ==0) x = 2;
            else x = x-1;
            deplacement(x, y);
            break;
        case 'L':
            if (y ==0) y = 2;
            else y = y-1;
            deplacement(x, y);
            break;
        case 'D':
            if (x ==2) x = 0;
            else x = x+1;
            deplacement(x, y);
            break;
        case 'R':
            if (y ==2) y = 0;
            else y = y+1;
            deplacement(x, y);
            break;
        }
        if (key == 'A') {
          makeMove(x,y);
          drawBoard();
        }

        
        // Check for win 
        checkForWin();
        if (win == true) currentState = WELCOME_SCREEN;
        win = false;
    }

            }

          }

        } else if (welcomeKeyPressed == 'S') {

          currentState = LED_SCREEN;
          display.clearDisplay();
          LEDScreen();

          // Utiliser une boucle while pour le menu LED

          while (currentState == LED_SCREEN) {

            char ledKeyPressed = getKeyPressed();

 

            if (ledKeyPressed == 'B') {

              currentState = WELCOME_SCREEN;

            } else{
             if (ledKeyPressed == 'U') {
              // Cycle to the next color
              currentColorIndex = (currentColorIndex + 1) % 10;
            } else if (ledKeyPressed == 'D') {
              // Cycle to the previous color
              currentColorIndex = (currentColorIndex + 9) % 10;
            }
            // Set the color based on the current color index
            setColor(getColorByIndex(currentColorIndex));

            }
          }
        }
  }
}